#include <SPI.h>
#include <Wire.h>
#include <Adafruit_GFX.h>
#include <Adafruit_SSD1306.h>
#define bt1 12
#define bt2 11
#define bt3 10
#define bt4 6
#define buz 3
#define SCREEN_WIDTH 128 // pixel ความกว้าง
#define SCREEN_HEIGHT 64 // pixel ความสูง 
// '119141082_521319322040693_3589759869297274761_n', 128x64px
// '119141082_521319322040693_3589759869297274761_n', 128x64px
const unsigned char myBitmap1 [] PROGMEM = {
  0xff, 0xff, 0xff, 0xff, 0xff, 0xff, 0xff, 0xff, 0xff, 0xff, 0xff, 0xff, 0xff, 0xff, 0xff, 0xff, 
  0xff, 0xff, 0xff, 0xff, 0xff, 0xff, 0xff, 0xff, 0xff, 0xff, 0x87, 0xff, 0xff, 0xff, 0xff, 0xff, 
  0xff, 0xff, 0xff, 0xff, 0xff, 0xff, 0xff, 0xff, 0xf9, 0xff, 0x83, 0xff, 0xff, 0xff, 0xff, 0xff, 
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  0xff, 0xff, 0xff, 0xff, 0xff, 0xff, 0xff, 0xff, 0xff, 0xff, 0xff, 0xff, 0xff, 0xff, 0xff, 0xff
};
// '66477226_279001302939164_4386200166667911168_n', 128x64px
const unsigned char bitmap [] PROGMEM = {
  0x00, 0x00, 0x00, 0x00, 0x00, 0x00, 0x00, 0x00, 0x00, 0x00, 0x00, 0x00, 0x00, 0x00, 0x00, 0x00, 
  0x00, 0x00, 0x00, 0x00, 0x00, 0x00, 0x00, 0x00, 0x00, 0x00, 0x00, 0x00, 0x00, 0x00, 0x00, 0x00, 
  0x00, 0x00, 0x00, 0x00, 0x00, 0x00, 0x00, 0x00, 0x00, 0x00, 0x00, 0x00, 0x00, 0x00, 0x00, 0x00, 
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  0x00, 0x00, 0x00, 0x00, 0x00, 0x00, 0x00, 0x00, 0x00, 0x00, 0x00, 0x00, 0x00, 0x00, 0x00, 0x00
};


// กำหนดขาต่อ I2C กับจอ OLED
#define OLED_RESET -1 //ขา reset เป็น -1 ถ้าใช้ร่วมกับขา Arduino reset
Adafruit_SSD1306 OLED(SCREEN_WIDTH, SCREEN_HEIGHT, &Wire, OLED_RESET);
 
int var = 0; // ตัวแปรสำหรับทดสอบแสดงผล
void setup() {
  
  pinMode(buz,OUTPUT);
  pinMode(bt1,INPUT);
  pinMode(bt2,INPUT);
  pinMode(bt3,INPUT);
  pinMode(bt4,INPUT);
  if (!OLED.begin(SSD1306_SWITCHCAPVCC, 0x3C)) { // สั่งให้จอ OLED เริ่มทำงานที่ Address 0x3C
Serial.println("SSD1306 allocation failed");
} else {
Serial.println("ArdinoAll OLED Start Work !!!");
}
 OLED.clearDisplay(); // ลบภาพในหน้าจอทั้งหมด
 OLED.display();
 OLED.drawBitmap(0, 0,  bitmap, 128, 64, WHITE);
 OLED.display();
 delay(3000);
 OLED.clearDisplay(); // ลบภาพในหน้าจอทั้งหมด
 OLED.display();
 delay(1000);
 tone(buz,5);
    delay(400);
    tone(buz,10);
     delay(400);
    tone(buz,15);
    delay(400);
    noTone(buz);
Serial.begin(9600);

}
 
void loop() {
int  val1 = digitalRead(bt1);
int  val2 = digitalRead(bt2);
int  val3 = digitalRead(bt3);
int  val4 = digitalRead(bt4);
OLED.clearDisplay(); // ลบภาพในหน้าจอทั้งหมด
OLED.setTextColor(WHITE, BLACK); //กำหนดข้อความสีขาว ฉากหลังสีดำ
OLED.setCursor(0, 0); // กำหนดตำแหน่ง x,y ที่จะแสดงผล
OLED.setTextSize(2); // กำหนดขนาดตัวอักษร
OLED.println("TIME rec"); // แสดงผลข้อความ ALL
 
OLED.setTextSize(1);
OLED.print("test project01");
OLED.println(" All");
OLED.setTextColor(BLACK, WHITE); //กลับสีข้อความกับพื้นหลัง
OLED.print("Atpm Robotic");
OLED.setTextColor(WHITE, BLACK);
OLED.setCursor(60, 0);
OLED.setTextSize(2);
OLED.println(var, DEC);
 
OLED.setCursor(0, 40);
OLED.setTextSize(2);
OLED.println("ATOM"); // แสดงผลข้อความ ALL
 
 
OLED.display(); // สั่งให้จอแสดงผล
var++;
delay(1000);
if(val1==1){
  Serial.println(bt1);
tone(buz,15);
delay(500);

}else if(val2==1){
   Serial.println(bt2);
tone(buz,15);
delay(500);
}else if(val3==1){
   Serial.println(bt3);
tone(buz,15);
delay(500);
}else if(val4==1){
   Serial.println(bt4);
   tone(buz,15);
delay(500);
}else{
    Serial.println("0");
noTone(buz);
}


}
